## board/elnico/sqm4vf6eb/Kconfig
```kconfig
if TARGET_SQM4VF6EB

config SYS_BOARD
	default "sqm4vf6eb"

config SYS_VENDOR
	default "elnico"

config SYS_SOC
	default "vf610"

config SYS_CONFIG_NAME
	default "sqm4vf6eb"

endif
```

## configs/sqm4sx6eb_eth2_defconfig
```kconfig
CONFIG_ARM=y
CONFIG_ARCH_MX6=y
CONFIG_TARGET_SQM4SX6EB=y
CONFIG_SYS_EXTRA_OPTIONS="IMX_CONFIG=board/elnico/sqm4sx6eb/sqm4sx6eb.cfg,MX6SX,ELNICO_FEC_ETH2"
# CONFIG_CMD_IMLS is not set
# CONFIG_CMD_FLASH is not set
CONFIG_CMD_GPIO=y
# CONFIG_CMD_SETEXPR is not set
CONFIG_SPI_FLASH=y
CONFIG_SPI_FLASH_BAR=y
```

## configs/sqm4vf6eb_defconfig
```kconfig
CONFIG_ARM=y
CONFIG_TARGET_SQM4VF6EB=y
CONFIG_SYS_EXTRA_OPTIONS="IMX_CONFIG=board/elnico/sqm4vf6eb/sqm4vf6eb.cfg,ENV_IS_IN_MMC"
# CONFIG_CMD_IMLS is not set
# CONFIG_CMD_SETEXPR is not set
CONFIG_DM=y
CONFIG_NAND_VF610_NFC=y
CONFIG_SYS_NAND_BUSWIDTH_16BIT=y
CONFIG_SPI_FLASH=y
```

## configs/sqm4vf6eb_nand_defconfig
```kconfig
CONFIG_ARM=y
CONFIG_TARGET_SQM4VF6EB=y
CONFIG_SYS_EXTRA_OPTIONS="IMX_CONFIG=board/elnico/sqm4vf6eb/sqm4vf6eb.cfg,ENV_IS_IN_NAND"
# CONFIG_CMD_IMLS is not set
# CONFIG_CMD_SETEXPR is not set
CONFIG_NAND_VF610_NFC=y
CONFIG_SPI_FLASH=y
```
